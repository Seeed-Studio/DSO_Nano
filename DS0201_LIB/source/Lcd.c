/*******************************************************************************
* File Name: lcd.c
*******************************************************************************/
#include "lcd.h"
#include "stm32f10x_it.h"
#include "HW_V1_Config.h"
#include "usb_lib.h"
#include "msd.h"

unsigned const short Char_Dot[760] =
{
   0x0000,0x0000,0x0000,0x001C,0x0020,0x0040,0x0040,0x0040,// "
   0x0040,0x0040,0x0020,0x001C,0x0000,0x0000,0x0000,0x0000,// #
   0x0000,0x0000,0x0000,0xE000,0x1000,0x0800,0x0800,0x0800,// $
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   0x0780,0x0480,0x3CF0,0x2010,0x2010,0x2010,0x2010,0x2010 // ~ Empty head
};                                            

unsigned const short Logo_Dot[] = {
  7,38,
  0xfc00,0x00ff,0x0000,0x0000,0x0000,0xfffe,0x0001,
  0xff00,0x03ff,0x0000,0x0000,0x0000,0xffff,0x0001,
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  0x3ff0,0x0000,0x0000,0x0000,0x0000,0x0000,0x0000
};

unsigned const char Ref_Buffer[304] = {
   100,116,130,144,157,167,175,181,185,185,184,179,173,164,153,141,128,114,100,86, 73, 60, 49, 40, 33, 27, 24, 24, 25, 29,
   35, 43, 52, 63, 75, 87, 100,112,124,135,145,153,160,164,167,167,166,163,157,150,142,133,122,111,100,89, 79, 70, 61, 54,
   48, 44, 42, 42, 43, 46, 50, 57, 64, 72, 81, 90, 100,109,118,126,133,139,144,147,149,149,148,146,142,137,130,124,116,108,
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   108,108,6,8
 };

unsigned short Get_Font_8x14(unsigned char chr, unsigned char row)
{
  unsigned  short idx = (chr - 0x22) * 8;
  
  return Char_Dot[idx + row];
}

unsigned char Get_Ref_Wave(unsigned short idx)
{
  return Ref_Buffer[idx];
}

/*******************************************************************************
 LCD_WR_REG: Set LCD Register  Input: Register addr., Data
*******************************************************************************/
void LCD_WR_REG(unsigned short Reg, unsigned short Data) 
{
  LDC_DATA_OUT=Reg;     //Reg. Addr.
  LCD_RS_LOW();         //RS=0,Piont to Index Reg.
  LCD_nWR_ACT();        //WR Cycle from 1 -> 0 -> 1
  LCD_RS_HIGH();        //RS=1,Piont to object Reg.
  LDC_DATA_OUT=Data;    //Reg. Data 
  LCD_nWR_ACT();        //WR Cycle from 1 -> 0 -> 1
}

/*******************************************************************************
 LCD  initializtion 
*******************************************************************************/
void LCD_Initial(void)
{   
  //------------------------- Reset LCD Driver ---------------------//
  LCD_DATA_BUS_OUT();   //Set LCD Data Bus as Output Mode
  LCD_nWR_HIGH();
  LCD_nRD_HIGH();       
  LCD_RS_HIGH();        //RS=1        
  LCD_nRST_HIGH(); 
  Delayms(1);           //RST=1£¬Delay 1ms      
  LCD_nRST_LOW(); 
  Delayms(1);          //RST=0 Reset LCD£¬Delay 1ms      
  LCD_nRST_HIGH(); 
  Delayms(5);          //RST=1£¬Delay 5 ms  
 //----------------ST7781 Internal Register Initial------------//         
  LCD_WR_REG(0x00FF, 0x0001);  
  LCD_WR_REG(0x00F3, 0x0008);  
  LDC_DATA_OUT=0x00F3;     
  LCD_RS_LOW();         
  LCD_nWR_ACT();       //Read Parameter      
  LCD_RS_HIGH();        
 //-------------------Display Control Setting-----------------//
  LCD_WR_REG(0x0001, 0x0100);    //Output Direct 
  LCD_WR_REG(0x0002, 0x0700);    //Line Inversion
  LCD_WR_REG(0x0003, 0x0030);    //BGR=0,ID=11
  LCD_WR_REG(0x0008, 0x0302);    //Porch Setting
  LCD_WR_REG(0x0009, 0x0000);    //Scan Cycle
  LCD_WR_REG(0x000A, 0x0000);    //FMARK off
 //----------------power Control Register Initial------------//
  LCD_WR_REG(0x0010, 0x0790);    //Power Control1
  LCD_WR_REG(0x0011, 0x0005);    //Power Control2
  LCD_WR_REG(0x0012, 0x0000);    //Power Control3
  LCD_WR_REG(0x0013, 0x0000);    //Power Control4
  Delayms(100);                  //Delay 100ms   
  LCD_WR_REG(0x0010, 0x12B0);    //Power Control1
  Delayms(50);                   //delay 50ms
  LCD_WR_REG(0x0011, 0x0007);    //Power Control2
  Delayms(50);                   //delay 50ms
  LCD_WR_REG(0x0012, 0x008C);    //Power Control3
  LCD_WR_REG(0x0013, 0x1700);    //Power Control4
  LCD_WR_REG(0x0029, 0x001A);    //VCOMH Setting
  Delayms(50);                   //delay 50ms
 //------------------GAMMA Cluster Setting-------------------//
  LCD_WR_REG(0x0030, 0x0000);
  LCD_WR_REG(0x0031, 0x0507);
  LCD_WR_REG(0x0032, 0x0003);
  LCD_WR_REG(0x0035, 0x0200);
  LCD_WR_REG(0x0036, 0x0106);
  LCD_WR_REG(0x0037, 0x0000);
  LCD_WR_REG(0x0038, 0x0507);
  LCD_WR_REG(0x0039, 0x0104);
  LCD_WR_REG(0x003C, 0x0200);
  LCD_WR_REG(0x003D, 0x0005);
 //------------------Display Windows 240*320-----------------//
  LCD_WR_REG(0x0050, 0x0000);
  LCD_WR_REG(0x0051, 0x00EF);
  LCD_WR_REG(0x0052, 0x0000);
  LCD_WR_REG(0x0053, 0x013F);
 //--------------------Frame Rate Setting--------------------//
  LCD_WR_REG(0x0060, 0xA700);
  LCD_WR_REG(0x0061, 0x0001);
  LCD_WR_REG(0x0090, 0x0033);
  LCD_WR_REG(0x0007, 0x0133);
  Delayms(50);                   //delay 50ms
}

/*******************************************************************************
Point_SCR: Set display position   Input: X, Y 
*******************************************************************************/
void Point_SCR(unsigned short x0, unsigned short y0) 
{
  LCD_WR_REG(0x0020,y0);
  LCD_WR_REG(0x0021,x0);
  LDC_DATA_OUT=0x0022;  //DRAM Reg.      
  LCD_RS_LOW();             
  LCD_nWR_ACT();        //WR Cycle from 1 -> 0 -> 1
  LCD_nWR_ACT();        //WR Cycle from 1 -> 0 -> 1
  LCD_RS_HIGH();            
}
/*******************************************************************************
 Set_Pixel: Set a Pixel  Input: Color
*******************************************************************************/
void Set_Pixel(unsigned short Color) 
{
  LDC_DATA_OUT=Color;   //Color Data
  LCD_nWR_ACT();        //WR Cycle from 1 -> 0 -> 1
}
/*******************************************************************************
 Clear Screen 
*******************************************************************************/
void Clear_Screen(unsigned short Color)						
{ 
  unsigned int i; 
  Point_SCR(0, 0);    //X_pos=0, Y_pos=0
  for(i=0;i<240*320;++i) Set_Pixel(Color);
}
/*******************************************************************************
 Display_Str: Display String   Input: x, y , Color, Mode, String  
*******************************************************************************/
void Display_Str(unsigned short x0, unsigned short y0, unsigned short Color, unsigned char Mode, unsigned const char *s)
{ 
  signed short i, j, b; 
  Point_SCR(x0, y0);
  for (j=0; j<14;++j) { 
    Set_Pixel(Mode?Color:BLACK);
  }
  x0++;        
  while (*s!=0) {
    unsigned const short *scanline=Char_Dot+((*s-0x22)*8);
    for(i=0;i<8;++i){
      Point_SCR(x0+i, y0);
      if((*s==0x20)||(*s==0x21)) b=0x0000;
      else                       b=scanline[i];
      if((*s==0x21)&&(i==4)) break;
      for(j=0;j<14;++j){
        if (b&4) {
          Set_Pixel(Mode?BLACK:Color);
        } else {
          Set_Pixel(Mode?Color:BLACK);
        }
        b>>=1;
      }
    }
    if(*s==0x21) x0 +=4;       
    else  x0 += 8;             
    ++s;                           //next character
  }
}
/*******************************************************************************
 Display_Logo: Display Logo   Input: X, Y 
*******************************************************************************/
void Display_Logo(unsigned short Dot_x, unsigned short Dot_y)
{ 
  unsigned short i, j, k, l, Color, b;

  Color = BLUE;
  k = 2;
  for (j=0; j < Logo_Dot[1]; j++) {
    for (i=0; i < Logo_Dot[0]; i++) {
      b = Logo_Dot[k];
      for (l = 0; l < 16; l++) {
        if (b & 1) {
          Point_SCR(Dot_x + i * 16 + l, Dot_y + Logo_Dot[1] - j);
          Set_Pixel(Color);
        }
        b =  b >> 1;
        if (b == 0) break;
      }
      k++;
    }
  }
  
  Color = WHITE;
  for (i=0; i<320; ++i)
  {
    Point_SCR(i, 0);
    Set_Pixel(Color);
    Point_SCR(i, 239);
    Set_Pixel(Color);
  }

  for (i=3; i<317; ++i)
  {
    Point_SCR(i, 3);
    Set_Pixel(Color);
    Point_SCR(i, 236);
    Set_Pixel(Color);
  }

  Point_SCR(0, 0);
  for (j=0; j<240; ++j) Set_Pixel(Color);
  Point_SCR(3, 3);
  for (j=3; j<237; ++j) Set_Pixel(Color);
  Point_SCR(316, 3);
  for (j=3; j<237; ++j) Set_Pixel(Color);
  Point_SCR(319, 0);
  for (j=0; j<240; ++j) Set_Pixel(Color);
}


void Display_Info(unsigned short x0, unsigned short y0, char *Pre, long Num)
{
  char  buf[10], n = 0, k, str[2] = {'-', 0};
  
  if (Pre) {
    char *p = Pre;
    while (*p) p++;
    Display_Str(x0, y0, WHITE, PRN, (unsigned char const *)Pre);
    x0 += (p - Pre) * 8 + 8;
  }

  if (Num < 0) {
    Display_Str(x0, y0, WHITE, PRN, (unsigned char const *)str);
    x0 += 8;
    Num = -Num;
  }

  do {  
    buf[n++] = Num % 10;
    Num /= 10;
  } while (Num > 0);

  k = n;
  
  for (; n > 0; n--) {
    str[0] = '0' + buf[n - 1];
    Display_Str(x0, y0, WHITE, PRN, (unsigned char const *)str);
    x0 += 8;
  }
  
  str[0] = ' ';
  while (k < 10) {
    Display_Str(x0, y0, WHITE, PRN, (unsigned char const *)str);
    x0 += 8;
    k++;
  }
  
}

/******************************** END OF FILE *********************************/
